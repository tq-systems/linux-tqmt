## drivers/net/ethernet/freescale/dpaa/Kconfig
```kconfig
menuconfig FSL_DPAA_ETH
	tristate "DPAA Ethernet"
	depends on FSL_SOC && FSL_BMAN && FSL_QMAN && FSL_FMAN
	select PHYLIB
	select FSL_FMAN_MAC
	---help---
	  Data Path Acceleration Architecture Ethernet driver,
	  supporting the Freescale QorIQ chips.
	  Depends on Freescale Buffer Manager and Queue Manager
	  driver and Frame Manager Driver.

if FSL_DPAA_ETH

config FSL_DPAA_ETH_USE_NDO_SELECT_QUEUE
	bool "Use driver's Tx queue selection mechanism"
	default y
	---help---
	  The DPAA Ethernet driver defines a ndo_select_queue() callback for optimal selection
	  of the egress FQ. That will override the XPS support for this netdevice.
	  If for whatever reason you want to be in control of the egress FQ-to-CPU selection and mapping,
	  or simply don't want to use the driver's ndo_select_queue() callback, then unselect this
	  and use the standard XPS support instead.

config FSL_DPAA_ETH_FRIENDLY_IF_NAME
	bool "Use fmX-macY names for the DPAA interfaces"
	default y
	---help---
	  The DPAA Ethernet netdevices are created for each FMan port available
	  on a certain board. Enable this to get interface names derived from
	  the underlying FMan hardware for a simple identification.

endif # FSL_DPAA_ETH
```

## drivers/soc/fsl/qbman/Kconfig
```kconfig
menuconfig FSL_DPA
	bool "Freescale DPAA support"
	depends on FSL_SOC
	default n
	help
		FSL Data-Path Acceleration Architecture drivers

		These are not the actual Ethernet driver(s)

if FSL_DPA

config FSL_DPA_CHECKING
	bool "additional driver checking"
	help
		Compiles in additional checks to sanity-check the drivers and
		any use of it by other code. Not recommended for performance

config FSL_BMAN
        bool "BMan Configuration Driver"
        default n
        help
                This driver initalizes the global setting for the Buffer Manager

                If this linux image is running natively, you need this option.
                If this linux image is running as a guest OS under the
                hypervisor, only one guest OS ("the control plane") needs this
                option.

config FSL_BMAN_PORTAL
        bool "BMan Portal Support"
        default n
        help
                FSL BMan portal driver.  This driver enables Buffer
                Manager Portal access

config FSL_BMAN_DEBUGFS
        tristate "BMan debugfs support"
        depends on DEBUG_FS
        depends on FSL_BMAN
        default n
        help
                BMan debugfs support


endif # FSL_DPA
```
